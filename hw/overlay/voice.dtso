/* hw/overlay/voice.dtso  — loaded at runtime together with the bitstream */
/dts-v1/;
/plugin/;
/ {
    fragment@0 {
        target = <&fpga_full>;
        __overlay__ {
            firmware-name = "voice_fe.bit.bin";
        };
    };
    fragment@1 {
        target = <&amba>;
        __overlay__ {
            axi_dma_uio: dma@40400000 {
                compatible = "generic-uio";
                reg = <0x40400000 0x10000>;    /* check address in Vivado Address Editor */
                interrupt-parent = <&intc>;
                interrupts = <0 29 4>;         /* IRQ_F2P[0] = GIC ID 61 → 61-32 = 29 */
            };
        };
    };
};
